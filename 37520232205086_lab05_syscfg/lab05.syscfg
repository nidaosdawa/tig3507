/**
 * @cliArgs --device "MSPM0G350X" --part "Default" --package "LQFP-64(PM)" --product "mspm0_sdk@2.06.00.05"
 * @versions {"tool":"1.21.0+3721"}
 */

/**
 * Import the modules used in this configuration.
 */
const ADC12         = scripting.addModule("/ti/driverlib/ADC12", {}, false);
const ADC121        = ADC12.addInstance();
const ADC122        = ADC12.addInstance();
const Board         = scripting.addModule("/ti/driverlib/Board");
const GPIO          = scripting.addModule("/ti/driverlib/GPIO", {}, false);
const GPIO1         = GPIO.addInstance();
const GPIO2         = GPIO.addInstance();
const GPIO3         = GPIO.addInstance();
const MATHACL       = scripting.addModule("/ti/driverlib/MATHACL");
const SYSCTL        = scripting.addModule("/ti/driverlib/SYSCTL");
const TIMER         = scripting.addModule("/ti/driverlib/TIMER", {}, false);
const TIMER1        = TIMER.addInstance();
const TIMER2        = TIMER.addInstance();
const ProjectConfig = scripting.addModule("/ti/project_config/ProjectConfig");

/**
 * Write custom configuration values to the imported modules.
 */
ADC121.$name              = "ADC12_0";
ADC121.sampClkDiv         = "DL_ADC12_CLOCK_DIVIDE_8";
ADC121.repeatMode         = true;
ADC121.sampleTime0        = "50 us";
ADC121.enabledInterrupts  = ["DL_ADC12_INTERRUPT_MEM0_RESULT_LOADED"];
ADC121.adcMem0trig        = "DL_ADC12_TRIGGER_MODE_TRIGGER_NEXT";
ADC121.adcMem0chansel     = "DL_ADC12_INPUT_CHAN_11";
ADC121.peripheral.$assign = "ADC0";

ADC122.$name                      = "ADC12_1";
ADC122.repeatMode                 = true;
ADC122.enabledADCMems             = [1];
ADC122.startAdd                   = 1;
ADC122.adcMem1_name               = "0";
ADC122.adcMem1trig                = "DL_ADC12_TRIGGER_MODE_TRIGGER_NEXT";
ADC122.adcMem1chansel             = "DL_ADC12_INPUT_CHAN_3";
ADC122.enabledInterrupts          = ["DL_ADC12_INTERRUPT_MEM1_RESULT_LOADED"];
ADC122.powerDownMode              = "DL_ADC12_POWER_DOWN_MODE_MANUAL";
ADC122.sampleTime1                = "0";
ADC122.sampClkDiv                 = "DL_ADC12_CLOCK_DIVIDE_32";
ADC122.sampleTime0                = "0.06s";
ADC122.peripheral.adcPin3.$assign = "PA18";
ADC122.adcPin3Config.$name        = "ti_driverlib_gpio_GPIOPinGeneric0";


GPIO1.$name                          = "GPIO_OLED_13";
GPIO1.port                           = "PORTA";
GPIO1.associatedPins.create(2);
GPIO1.associatedPins[0].$name        = "GPIO_SDA";
GPIO1.associatedPins[0].initialValue = "SET";
GPIO1.associatedPins[0].assignedPin  = "28";
GPIO1.associatedPins[1].assignedPin  = "31";
GPIO1.associatedPins[1].$name        = "GPIO_SCK";
GPIO1.associatedPins[1].initialValue = "SET";

GPIO2.$name                          = "GPIO_LEDs";
GPIO2.associatedPins.create(2);
GPIO2.associatedPins[0].$name        = "LED_R";
GPIO2.associatedPins[0].assignedPort = "PORTB";
GPIO2.associatedPins[0].assignedPin  = "26";
GPIO2.associatedPins[1].assignedPort = "PORTB";
GPIO2.associatedPins[1].assignedPin  = "27";
GPIO2.associatedPins[1].$name        = "LED_G";

GPIO3.$name                          = "GPIO_LED1";
GPIO3.associatedPins[0].$name        = "LED1";
GPIO3.associatedPins[0].assignedPort = "PORTA";
GPIO3.associatedPins[0].assignedPin  = "0";

SYSCTL.forceDefaultClkConfig = true;

TIMER1.interrupts       = ["ZERO"];
TIMER1.timerMode        = "PERIODIC";
TIMER1.$name            = "TIMER_5086";
TIMER1.timerClkDiv      = 8;
TIMER1.timerClkPrescale = 2;
TIMER1.timerPeriod      = "0.000196618s";
TIMER1.timerStartTimer  = true;

TIMER2.$name            = "TIMER_1S";
TIMER2.timerMode        = "PERIODIC_UP";
TIMER2.timerPeriod      = "1 s";
TIMER2.timerClkDiv      = 8;
TIMER2.timerClkPrescale = 100;
TIMER2.interrupts       = ["ZERO"];

ProjectConfig.genLibIQ        = true;
ProjectConfig.genLibIQVersion = "MATHACL";

/**
 * Pinmux solution for unlocked pins/peripherals. This ensures that minor changes to the automatic solver in a future
 * version of the tool will not impact the pinmux you originally saw.  These lines can be completely deleted in order to
 * re-solve from scratch.
 */
ADC122.peripheral.$suggestSolution           = "ADC1";
Board.peripheral.$suggestSolution            = "DEBUGSS";
Board.peripheral.swclkPin.$suggestSolution   = "PA20";
Board.peripheral.swdioPin.$suggestSolution   = "PA19";
GPIO1.associatedPins[0].pin.$suggestSolution = "PA28";
GPIO1.associatedPins[1].pin.$suggestSolution = "PA31";
GPIO2.associatedPins[0].pin.$suggestSolution = "PB26";
GPIO2.associatedPins[1].pin.$suggestSolution = "PB27";
GPIO3.associatedPins[0].pin.$suggestSolution = "PA0";
SYSCTL.peripheral.$suggestSolution           = "SYSCTL";
TIMER1.peripheral.$suggestSolution           = "TIMA1";
TIMER2.peripheral.$suggestSolution           = "TIMA0";
